## basedefconfig
```kconfig
BR2_INIT_NONE=y
BR2_ROOTFS_MERGED_USR=y
# BR2_TARGET_ENABLE_ROOT_LOGIN is not set
# BR2_TARGET_GENERIC_GETTY is not set
BR2_ENABLE_LOCALE_WHITELIST="C POSIX"
BR2_PACKAGE_BUSYBOX_CONFIG="busybox.config"
BR2_TARGET_ROOTFS_SQUASHFS=y
BR2_TARGET_ROOTFS_SQUASHFS4_XZ=y
```

## knot/Config.in
```kconfig
config BR2_PACKAGE_KNOT
	bool "knot"
	depends on BR2_USE_MMU # well, probably?
	select BR2_PACKAGE_GNUTLS
	select BR2_PACKAGE_LIBEDIT
	select BR2_PACKAGE_LIBURCU
	select BR2_PACKAGE_LIBLMDB
	help
	  Knot DNS is an authoritive DNS server
	  https://www.knot-dns.cz
```

## liblmdb/Config.in
```kconfig
config BR2_PACKAGE_LIBLMDB
	bool "liblmdb"
	help
	  The Lightning memory-mapped database
	  https://www.symas.com/lmdb
```

## lyrebird/Config.in
```kconfig
config BR2_PACKAGE_LYREBIRD
        bool "nerdctl"
        depends on BR2_PACKAGE_HOST_GO_TARGET_ARCH_SUPPORTS
```

## tcdefconfig
```kconfig
BR2_@arch@=y
BR2_OPTIMIZE_2=y
BR2_TOOLCHAIN_BUILDROOT_MUSL=y
BR2_KERNEL_HEADERS_5_10=y
BR2_TOOLCHAIN_CXX=y
```
